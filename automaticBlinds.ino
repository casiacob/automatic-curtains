#include <AccelStepper.h>
#define BLYNK_PRINT Serial
#include <ESP8266WiFi.h>
#include <BlynkSimpleEsp8266.h>
#include<Ticker.h>

/*
Components:
Nema 17 stepper motor
a4988 driver
ESP8266 board 
100 uF Capacitor
Connecting Wires
12V power supply for the motor
*/

//unique authentication token generated by blynk
char auth[] = "___"; 

//wi-fi credentials
char ssid[] = "___";
char pass[] = "___";

int up = 0; //blynk button data for up
int down = 0; //blynk button data for down
int stopp = 0;

const int e = D5; //enable pin
int p = 0; //stepper position

Ticker counter;

AccelStepper stepper(1, D3, D4); //stepper object

//rolling the curtains up
BLYNK_WRITE(V0) {
  up = param.asInt();
  digitalWrite(e, LOW); //enable driver
  if (up) {
    stepper.setAcceleration(1);
    stepper.setMaxSpeed(180);
    p = 3800; //steper will move to position p
    stepper.moveTo(p);
  }
}

//rolling the curtuins down
BLYNK_WRITE(V1) {
  down = param.asInt();
  digitalWrite(e, LOW);
  if (down) {
    stepper.setAcceleration(10);
    stepper.setMaxSpeed(250);
    p = 1; //stepper will move to p
    stepper.moveTo(p);
  }
}

BLYNK_WRITE(V2){
  stopp = param.asInt();
  if(stopp){
    stepper.setAcceleration(20);
    stepper.stop();
  }
}

void rotate(){
  stepper.run(); 
}

void setup()
{
  pinMode(e, OUTPUT);
  Blynk.begin(auth, ssid, pass);
  counter.attach_ms(1, rotate); //rotate() runs every 1 ms
}

void loop()
{
  Blynk.run();
  if(stepper.distanceToGo() == 0)
  digitalWrite(e, HIGH); //disabling driver after arriving to destination
                          
}
